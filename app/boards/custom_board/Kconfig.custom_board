## app/boards/custom_board/Kconfig.custom_board
```kconfig
# Copyright (c) 2019 Roland Ma
# SPDX-License-Identifier: Apache-2.0

config BOARD_CUSTOM_BOARD
	select SOC_STM32F767XX
```

## app/boards/custom_board/board.yml
```yaml
board:
  name: custom_board
  full_name: Nucleo F767ZI
  vendor: st
  socs:
    - name: stm32f767xx
```
